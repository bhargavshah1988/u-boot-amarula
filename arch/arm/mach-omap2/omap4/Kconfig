## arch/arm/mach-omap2/omap4/Kconfig
```kconfig
if OMAP44XX

choice
	prompt "OMAP4 board select"
	optional

config TARGET_KC1
	bool "Amazon Kindle Fire (first generation)"

endchoice

config SYS_SOC
	default "omap4"

source "board/amazon/kc1/Kconfig"

endif
```

## drivers/phy/rockchip/Kconfig
```kconfig
#
# Phy drivers for Rockchip platforms
#
config PHY_ROCKCHIP_PCIE
        tristate "Rockchip PCIe PHY Driver"
        depends on ARCH_ROCKCHIP
        select PHY
        select REGMAP 
        help
          Enable this to support the Rockchip PCIe PHY.
```
